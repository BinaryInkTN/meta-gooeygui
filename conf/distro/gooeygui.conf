## conf/distro/gooeygui.conf
```bitbake
# this distro is inspired from the tegra-demo distro 
DISTRO = "gooeygui"
DISTRO_NAME = "Mare Cutos Refrence distro for the seabot robot"
DISTRO_VERSION = "1.0"
# sets a codename to the distro  
DISTRO_CODENAME = "alpha"
# add a vendor suffix to the sdk name 

MAINTAINER = "Moktar SELLAMI <smokthar925@gmail.com>"
#set a target vendor 
TARGET_VENDOR = "-gy"

# setup distro features 
SB_DEFAULT_DISTRO_FEATURES = "multiarch usrmerg systemd pam  opengl x11"
DISTRO_FEATURES ?= "${DISTRO_FEATURES_DEFAULT} ${SB_DEFAULT_DISTRO_FEATURES}"

# setup machine features 
#adding support to systemd 
INIT_MANAGER = "systemd"

# add cve checks for recipes 
# INHERIT += "cve-check" : TODO understand it better and its effects 

# set preferred kernel

TCLIBCAPPEND = ""

# set package management
PACKAGE_CLASSES = "package_deb"

# inlude other configs, taken 
require conf/distro/include/no-static-libs.inc
require conf/distro/include/yocto-uninative.inc
require conf/distro/include/security_flags.inc
# isolates he build system from the host system 
INHERIT += "uninative"


SDK_VENDOR = "-sbsdk"
# sets the sdk version and removes the meta data from it "1.0+snapshot"
# makes the sdk version shorter 
SDK_VERSION = "${@d.getVar('DISTRO_VERSION').replace('snapshot-${METADATA_REVISION}', 'snapshot')}"
# ensures 
SDK_VERSION[vardepvalue] = "${SDK_VERSION}"
# set sdk name 
SDK_NAME = "${DISTRO}-${TCLIBC}-${SDKMACHINE}-${IMAGE_BASENAME}-${TUNE_PKGARCH}-${MACHINE}"
SDKPATHINSTALL = "/opt/${DISTRO}/${SDK_VERSION}"


LICENSE_FLAGS_ACCEPTED = "synaptics-killswitch"
```

## conf/layer.conf
```bitbake
BBPATH .= ":${LAYERDIR}"
BBFILES += "${LAYERDIR}/recipes-*/*/*.bb ${LAYERDIR}/recipes-*/*/*.bbappend"
BBFILE_COLLECTIONS += "gooeygui"
BBFILE_PATTERN_gooeygui = "^${LAYERDIR}/"
BBFILE_PRIORITY_gooeygui = "6"

# LAYERDEPENDS_gooeygui = "core"
LAYERSERIES_COMPAT_gooeygui = "scarthgap"
```
